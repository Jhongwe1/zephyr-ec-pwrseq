## CMakeLists.txt
```
# SPDX-License-Identifier: Apache-2.0

cmake_minimum_required(VERSION 3.20.0)

find_package(Zephyr REQUIRED HINTS $ENV{ZEPHYR_BASE})
project(zephyr_ec_pwrseq LANGUAGES C)

target_include_directories(app PRIVATE include)

target_sources(app PRIVATE
  src/main.c
)

# Sources added as the project grows (kept here as a visible roadmap):
#   src/pwrseq.c      P1  devicetree-driven rail sequencer
#   src/smf_states.c  P2  hierarchical state machine
#   src/invariant.c   P2  independent invariant observer
#   src/ec_trace.c    P2  cycle-timestamped event ring buffer
```

## west.yml
```
# SPDX-License-Identifier: Apache-2.0
#
# West manifest for zephyr-ec-pwrseq.
#
# This repository is the MANIFEST REPO of its own west workspace (Zephyr "T2"
# topology).  Cloning this repo and running `west init -l . && west update`
# reproduces the exact Zephyr tree this project was built and measured against.
#
#   ec-ws/                     <- workspace top directory
#   |-- .west/                 <- created by `west init -l`
#   |-- zephyr-ec-pwrseq/      <- THIS REPO (the manifest repo + the application)
#   |-- zephyr/                <- fetched by `west update`, pinned below
#   `-- modules/               <- fetched by `west update`
#
# Why pin at all:
#   Every timing number and every waveform in README.md was produced against
#   one specific Zephyr tree.  An unpinned manifest means a reader gets a
#   different tree than the one that was measured, and "reproducible" becomes
#   a claim instead of a fact.  It also stops CI from turning red because
#   upstream main moved while nothing in this repo changed.
#
# Why v4.4.2 and not v4.4.0:
#   4.4.0 (2026-04) is the first Zephyr release supporting Zephyr SDK 1.0.
#   4.4.1 and 4.4.2 are maintenance releases on that same 4.4 branch --
#   bug fixes only, no API changes -- so taking the newest patch level costs
#   nothing and picks up fixes.  The pin is re-evaluated on each MINOR release
#   (4.5, 4.6, ...), because those may change APIs; see docs/runbook/R01.
#
# How to move the pin (do this deliberately, never casually):
#   1. change `revision` below
#   2. west update
#   3. make test && make build          <- both must stay green
#   4. commit the manifest change ALONE, with the reason in the message

manifest:
  self:
    path: zephyr-ec-pwrseq

  remotes:
    - name: zephyrproject-rtos
      url-base: https://github.com/zephyrproject-rtos

  projects:
    - name: zephyr
      remote: zephyrproject-rtos
      revision: v4.4.2
      # TODO(P3): once the module set is known (`west list`), narrow this to
      # `import: {name-allowlist: [...]}`.  A trimmed workspace makes CI
      # noticeably faster.  Not done now: a wrong allowlist fails the build
      # with a confusing error, and bringing the toolchain up must not be
      # blocked on an optimisation.  Correctness first, then speed.
      import: true
```

## prj.conf
```kconfig
# SPDX-License-Identifier: Apache-2.0
#
# Application configuration.
#
# Deliberately minimal at P0.  Options are added when the code that needs
# them is added, never "just in case" -- dead Kconfig is indistinguishable
# from configuration that matters, and on an EC every kilobyte is real.

CONFIG_LOG=y

# TODO(P4): revisit the logging mode before the first logic-analyser capture.
#
# Zephyr's default deferred logging hands the message to a background thread,
# so the UART bytes leave the pin some time AFTER the event they describe.
# That is invisible on a terminal and fatal for this project: capture profile B
# puts UART1_TX on logic-analyser channel 7 in order to align the firmware's
# own log against the measured edges on ONE time axis.  If the log lags the
# edge by an unknown amount, the alignment proves nothing.
#
# Immediate mode (CONFIG_LOG_MODE_IMMEDIATE) removes the lag but makes the
# logging call block the sequencer thread, which perturbs the very timing
# being measured.  Neither default is automatically right; the decision needs
# a measurement, and the measurement does not exist yet.  Decide in P4 and
# record the reasoning in docs/timing_budget.md.
```

## src/main.c
```c
/* SPDX-License-Identifier: Apache-2.0
 *
 * zephyr-ec-pwrseq -- laptop EC power-sequencing state machine.
 *
 * P0 scope: prove the toolchain end to end THROUGH THIS REPOSITORY.
 *
 * Building an upstream Zephyr sample proves Zephyr builds.  It does not prove
 * that this repo's manifest, CMakeLists, Kconfig and board selection are
 * right.  Those are separate failure modes, and discovering them while also
 * debugging a state machine costs far more than discovering them alone.  So
 * the first commit that runs is the smallest one that exercises the whole
 * chain.
 *
 * The sequencer, the state machine and the fault handling arrive in P1-P2.
 */

#include <zephyr/kernel.h>
#include <zephyr/logging/log.h>
#include <zephyr/sys/util.h>
#include <version.h>

LOG_MODULE_REGISTER(ec_main, LOG_LEVEL_INF);

int main(void)
{
	LOG_INF("zephyr-ec-pwrseq (P0 skeleton)");
	LOG_INF("board  : %s", CONFIG_BOARD_TARGET);
	LOG_INF("zephyr : %s", KERNEL_VERSION_STRING);

	/* The resolution ceiling of every timing number this project will
	 * ever report.
	 *
	 * k_cycle_get_32() is the firmware-side clock used to timestamp EN and
	 * PG edges, and in P4 those timestamps get compared against the logic
	 * analyser's independent measurement of the same edges.  That
	 * comparison is only meaningful if the tick rate is known rather than
	 * assumed, and it is NOT a constant: it depends on the SoC clock tree
	 * and differs between the board and native_sim.
	 *
	 * Printing it at boot costs one line and makes every later measurement
	 * self-documenting -- the number is in the log next to the data it
	 * bounds.
	 */
	uint32_t hz = sys_clock_hw_cycles_per_sec();

	LOG_INF("cycle counter: %u Hz (%u ns per tick)", hz, (unsigned int)(1000000000ULL / hz));

	LOG_INF("skeleton up; sequencer lands in P1");

	return 0;
}
```
